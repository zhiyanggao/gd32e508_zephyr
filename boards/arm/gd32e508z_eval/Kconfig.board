## boards/arm/gd32e508z_eval/Kconfig.board
```kconfig
# Copyright (c) 2022, Teslabs Engineering S.L.
# SPDX-License-Identifier: Apache-2.0

config BOARD_GD32E508Z_EVAL
	bool "GigaDevice GD32E508Z-EVAL"
	depends on SOC_GD32E508

	select USE_GD32_USBHS
	select USE_GD32_CAN
```

## boards/arm/gd32e508z_eval/Kconfig.defconfig
```kconfig
# Copyright (c) 2022 Teslabs Engineering S.L.
# SPDX-License-Identifier: Apache-2.0

if BOARD_GD32E508Z_EVAL

config BOARD
	default "gd32e508z_eval"

endif # BOARD_GD32E508Z_EVAL
```

## dts/bindings/can/gd,gd32-can.yaml
```yaml
description: GD32 CAN controller

compatible: "gd,gd32-can"

include: [can-fd-controller.yaml, pinctrl-device.yaml]

properties:
  reg:
    required: true

  interrupts:
    required: true

  clocks:
    required: true

  pinctrl-0:
    required: true

  pinctrl-names:
    required: true
    
  master-can-reg:
    type: int
    description: master can reg when different from current instance
```
